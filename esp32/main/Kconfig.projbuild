## esp32/main/Kconfig.projbuild
```kconfig
menu "Mini Pupper Configuration"

    config CONSOLE_MAX_COMMAND_LINE_LENGTH
        int "Maximum command line length"
        default 1024
        help
            This value marks the maximum length of a single command line. Once it is
            reached, no more characters will be accepted by the console.

endmenu
```
